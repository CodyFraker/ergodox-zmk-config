## config/west.yml
```yaml
manifest:
  remotes:
    - name: slicemk
      url-base: https://github.com/xudongzheng/zmk/tree/v20250120-min
  projects:
    - name: zmk
      remote: slicemk
      revision: main
      import: app/west.yml
  self:
    path: config
```
